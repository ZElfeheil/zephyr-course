## app/Kconfig.heartbeat
```kconfig
config APP_HEARTBEAT_PERIOD_MS
	int "Application heartbeat period (ms)"
	range 100 2000
	default 500
```

## app/boards/my_board/board.yml
```yaml
board:
  name: my_board
  full_name: My Board
  vendor: my_vendor
  socs:
  - name: mcxn947
```

## boards/my_board/Kconfig.my_board
```kconfig
# Copyright 2024 NXP
# SPDX-License-Identifier: Apache-2.0

config BOARD_MY_BOARD
	select SOC_MCXN947_CPU0 if BOARD_MY_BOARD_MCXN947_CPU0
	select SOC_PART_NUMBER_MCXN947VDF
```

## boards/our_board/Kconfig.our_board
```kconfig
config BOARD_OUR_BOARD
	select BOARD_EARLY_INIT_HOOK
	select SOC_MCXN947_CPU0 if BOARD_OUR_BOARD
	select SOC_PART_NUMBER_MCXN947VDF
```
